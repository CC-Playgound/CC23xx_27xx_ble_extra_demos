/**
 * @cliArgs --board "/ti/boards/LP_EM_CC2745R10_Q1" --device "CC2745R10RHAQ1" --part "Default" --package "RHA" --rtos "freertos" --product "simplelink_lowpower_f3_source_sdk@9.20.00.81"
 * @versions {"tool":"1.26.3+4529"}
 */

/**
 * Import the modules used in this configuration.
 */
const FreeRTOS   = scripting.addModule("/freertos/FreeRTOS");
const ble        = scripting.addModule("/ti/ble/ble");
const CCFG       = scripting.addModule("/ti/devices/CCFG");
const rfdesign   = scripting.addModule("/ti/devices/radioconfig/rfdesign");
const NVS        = scripting.addModule("/ti/drivers/NVS");
const NVS1       = NVS.addInstance();
const Power      = scripting.addModule("/ti/drivers/Power");
const RCL        = scripting.addModule("/ti/drivers/RCL");
const RNG        = scripting.addModule("/ti/drivers/RNG");
const Button     = scripting.addModule("/ti/drivers/apps/Button", {}, false);
const Button1    = Button.addInstance();
const Button2    = Button.addInstance();
const LogModule  = scripting.addModule("/ti/log/LogModule", {}, false);
const LogModule1 = LogModule.addInstance();
const Settings   = scripting.addModule("/ti/posix/freertos/Settings");

/**
 * Write custom configuration values to the imported modules.
 */
FreeRTOS.heapSize       = 0x00010000;
FreeRTOS.timerStackSize = 0x00000190;
FreeRTOS.idleStackSize  = 0x00000130;

ble.basicBLE                              = true;
ble.keyNode                               = true;
ble.deviceName                            = "Key Node";
ble.maxPDUSize                            = 255;
ble.maxPDUNum                             = 20;
ble.disableDisplayModule                  = true;
ble.L2CAPCOC                              = true;
ble.numOfAdvSets                          = 1;
ble.maxBonds                              = 1;
ble.bondIOCaps                            = "GAPBOND_IO_CAP_NO_INPUT_NO_OUTPUT";
ble.connectionMonitorRole                 = true;
ble.channelSounding                       = true;
ble.rangingServer                         = true;
ble.deviceRole                            = "PERIPHERAL_CFG+CENTRAL_CFG";
ble.maxConnNum                            = 4;
ble.scanInt                               = 100;
ble.scanWin                               = 70;
ble.scanDuration                          = 0;
ble.centraSupTimeout                      = 2000;
ble.defaultTxPowerValue                   = "8";
ble.connIntMin                            = 40;
ble.connIntMax                            = 40;
ble.radioConfig.codeExportConfig.$name    = "ti_devices_radioconfig_code_export_param0";
ble.adcNoiseConfig.codeExportConfig.$name = "ti_devices_radioconfig_code_export_param1";
ble.bleCsConfig.codeExportConfig.$name    = "ti_devices_radioconfig_code_export_param2";
ble.connUpdateParamsPeripheral.$name      = "ti_ble_general_ble_conn_update_params1";
ble.advSet1.$name                         = "ti_ble_broadcaster_advertisement_set0";
ble.advSet1.advParam1.$name               = "ti_ble_broadcaster_advertisement_params0";
ble.advSet1.advData1.$name                = "ti_ble_broadcaster_advertisement_data0";
ble.advSet1.scanRes1.$name                = "ti_ble_broadcaster_advertisement_data1";
ble.rng.$name                             = "CONFIG_RNG_0";
ble.aesccm.$name                          = "CONFIG_AESCCM_0";
ble.ecdh.$name                            = "CONFIG_ECDH_0";
ble.aesctrdrbg.$name                      = "CONFIG_AESCTRDRBG_0";
ble.aesecb.$name                          = "CONFIG_AESECB_0";
ble.connUpdateParamsCentral.$name         = "ti_ble_general_ble_conn_update_params0";

CCFG.ccfgTemplate.$name = "ti_devices_CCFG_CCFGCC27XXTemplate0";

NVS1.$name                    = "CONFIG_NVSINTERNAL";
NVS1.internalFlash.$name      = "ti_drivers_nvs_NVSLPF30";
NVS1.internalFlash.regionBase = 0xE5000;
NVS1.internalFlash.regionSize = 0x3000;

RCL.pbeGpoMask = 0x0C;
RCL.useCase    = ["rfDebugSignals"];

RNG.rngReturnBehavior = "RNG_RETURN_BEHAVIOR_BLOCKING";

Button1.$name     = "CONFIG_BUTTON_0";
Button1.$hardware = system.deviceData.board.components["BTN-1"];

Button2.$name     = "CONFIG_BUTTON_1";
Button2.$hardware = system.deviceData.board.components["BTN-2"];

const AESCommonXXF3 = scripting.addModule("/ti/drivers/cryptoutils/aes/AESCommonXXF3", {}, false);

LogModule1.$name = "LogModule0";

const LogSinkBuf  = scripting.addModule("/ti/log/LogSinkBuf", {}, false);
const LogSinkBuf1 = LogSinkBuf.addInstance({}, false);
LogSinkBuf1.$name = "CONFIG_ti_log_LogSinkBuf_0";
LogModule1.logger = LogSinkBuf1;

/**
 * References between modules.
 */
CCFG.defaultLfoscCompProfile = null;

/**
 * Pinmux solution for unlocked pins/peripherals. This ensures that minor changes to the automatic solver in a future
 * version of the tool will not impact the pinmux you originally saw.  These lines can be completely deleted in order to
 * re-solve from scratch.
 */
RCL.lrfGpio.$suggestSolution                         = "LRF";
RCL.lrfGpio.rfegpo0Pin.$suggestSolution              = "boosterpack.6";
RCL.lrfGpio.rfegpo1Pin.$suggestSolution              = "boosterpack.2";
Button1.button.$suggestSolution                      = "boosterpack.30";
Button2.button.$suggestSolution                      = "boosterpack.40";
AESCommonXXF3.laes.$suggestSolution                  = "LAES";
AESCommonXXF3.laes.dataLaesChannelA.$suggestSolution = "DMA_CH4";
AESCommonXXF3.laes.dataLaesChannelB.$suggestSolution = "DMA_CH5";
