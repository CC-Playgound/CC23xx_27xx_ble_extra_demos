/**
 * @cliArgs --board "/ti/boards/LP_EM_CC2340R53" --device "CC2340R53RKP" --part "Default" --package "RKP" --rtos "freertos" --product "simplelink_lowpower_f3_sdk@9.20.01.21"
 * @versions {"tool":"1.26.3+4529"}
 */

/**
 * Import the modules used in this configuration.
 */
const FreeRTOS  = scripting.addModule("/freertos/FreeRTOS");
const Board     = scripting.addModule("/ti/drivers/Board");
const GPIO      = scripting.addModule("/ti/drivers/GPIO");
const LGPTimer  = scripting.addModule("/ti/drivers/LGPTimer", {}, false);
const LGPTimer1 = LGPTimer.addInstance();
const Power     = scripting.addModule("/ti/drivers/Power");
const LED       = scripting.addModule("/ti/drivers/apps/LED", {}, false);
const LED1      = LED.addInstance();
const Settings  = scripting.addModule("/ti/posix/freertos/Settings");

/**
 * Write custom configuration values to the imported modules.
 */
Board.generateInitializationFunctions = false;

LGPTimer1.$name                = "CONFIG_LGPTIMER_0";
LGPTimer1.channel0Connection   = "Pin";
LGPTimer1.timer.$assign        = "LGPT0";
LGPTimer1.timer.ch0Pin.$assign = "boosterpack.18";

const CCFG              = scripting.addModule("/ti/devices/CCFG", {}, false);
CCFG.ccfgTemplate.$name = "ti_devices_CCFG_CCFGCC23X0Template0";

LED1.$name     = "CONFIG_GPIO_LED_0";
LED1.$hardware = system.deviceData.board.components.LED_GREEN;

/**
 * Pinmux solution for unlocked pins/peripherals. This ensures that minor changes to the automatic solver in a future
 * version of the tool will not impact the pinmux you originally saw.  These lines can be completely deleted in order to
 * re-solve from scratch.
 */
LED1.ledPin.$suggestSolution = "boosterpack.40";
